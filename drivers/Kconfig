## drivers/Kconfig
```kconfig
menu "Device Drivers"

rsource "auxdisplay/Kconfig"
rsource "input/Kconfig"
endmenu
```

## drivers/auxdisplay/Kconfig
```kconfig
menu "Auxiliary (textual) Display Drivers"

if AUXDISPLAY

rsource "Kconfig.ssd1311"

endif

endmenu
```

## drivers/auxdisplay/Kconfig.ssd1311
```kconfig
config AUXDISPLAY_SSD1311
    bool "SSD1311 display driver"
    default n
    depends on I2C || SPI
    help
        Enable driver for SSD1311 display driver.
```

## drivers/input/Kconfig
```kconfig
menu "Input Drivers"

if INPUT

rsource "Kconfig.crtouch"
rsource "Kconfig.tsi"

endif

endmenu
```

## drivers/input/Kconfig.crtouch
```kconfig
menuconfig INPUT_CRTOUCH
    bool "CRTouch input driver"
    default y
    depends on I2C || SPI
    depends on DT_HAS_NXP_CRTOUCH_ENABLED
    select INPUT_TOUCH
    help
        Enable driver for NXP CRTouch driver.

if INPUT_CRTOUCH

config INPUT_CRTOUCH_PERIOD
	int "Sample period"
	depends on !INPUT_CRTOUCH_INTERRUPT
	default 10
	help
	  Sample period in milliseconds when in polling mode.

config INPUT_CRTOUCH_INTERRUPT
	bool "Interrupt"
	default y if $(dt_compat_any_has_prop,$(DT_COMPAT_NXP_CRTOUCH),int-gpios)
	help
	  Enable interrupt support (requires GPIO).

endif
```

## drivers/input/Kconfig.tsi
```kconfig
menuconfig INPUT_TSI
    bool "NXP Touch-sense-input driver"
    default y
    depends on DT_HAS_NXP_TSI_KEYS_ENABLED
    help
        Enable driver for NXP TSI driver.

#if INPUT_TSI
#
#config INPUT_CRTOUCH_PERIOD
#	int "Sample period"
#	depends on !INPUT_CRTOUCH_INTERRUPT
#	default 10
#	help
#	  Sample period in milliseconds when in polling mode.
#
#config INPUT_CRTOUCH_INTERRUPT
#	bool "Interrupt"
#	default y if $(dt_compat_any_has_prop,$(DT_COMPAT_NXP_CRTOUCH),int-gpios)
#	help
#	  Enable interrupt support (requires GPIO).
#
#endif
```

## dts/bindings/nxp,crtouch.yaml
```yaml
description: CRTouch

compatible: "nxp,crtouch"

include: [i2c-device.yaml]


properties:
  int-gpios:
    type: phandle-array
    required: false
    description: Reset pin

  sample-rate:
    type: int
    required: false
    default: 8

#  font-width:
#    type: int
#    required: false
#    description: Font width
#    enum:
#      - 5
#      - 6
#
#  invert-cursor:
#    type: boolean
#    required: false
#
#  reset-gpios:
#    type: phandle-array
#    required: false
#    description: Reset pin
#
#  phys-rows:
#    type: int
#    required: false
#    default: 4
#
#  contrast:
#    type: int
#    required: false
#    default: 255
```

## dts/bindings/nxp,tsi-keys.yaml
```yaml
# Copyright (c) 2024 Chen Xingyu <hi@xingrz.me>
# SPDX-License-Identifier: Apache-2.0

description: |
  Input driver for ADC attached resistor ladder buttons.

  The driver itself does not calculate each possible combination of resistor
  values. Instead, users are required to specify the voltage for each single
  key press or for combinations of key presses.

  Example:

  #include <dt-bindings/input/input-event-codes.h>

  / {
          buttons {
                  compatible = "adc-keys";
                  io-channels = <&adc 2>;
                  keyup-threshold-mv = <0>;

                  key_0 {
                          press-thresholds-mv = <1650>,  /* KEY0 */
                                                <2536>;  /* KEY0 + KEY1 */
                          zephyr,code = <INPUT_KEY_0>;
                  };

                  key_1 {
                          press-thresholds-mv = <2300>,  /* KEY1 */
                                                <2536>;  /* KEY0 + KEY1 */
                          zephyr,code = <INPUT_KEY_1>;
                  };
          };
  };

compatible: "nxp,tsi-keys"

include: base.yaml

properties:
#  io-channels:
#    type: phandle-array
#    required: true
#    description: Phandle to an ADC channel.

  interrupts:
    required: true

  scans-per-electrode:
    type: int
    default: 1
    required: false

  ref-charge-current-ua:
    type: int
    default: 2
    enum:
      - 2
      - 4
      - 6
      - 8
      - 10
      - 12
      - 14
      - 16
      - 18
      - 20
      - 22
      - 24
      - 26
      - 28
      - 30
      - 32
    description: |
      Ref oscillator charge current.

  ext-charge-current-ua:
    type: int
    default: 2
    enum:
      - 2
      - 4
      - 6
      - 8
      - 10
      - 12
      - 14
      - 16
      - 18
      - 20
      - 22
      - 24
      - 26
      - 28
      - 30
      - 32
    description: |
      External oscillator charge current.

  sample-period-ms:
    type: int
    default: 20
    description: |
       Sample period in milliseconds.
       If not specified defaults to 20.

child-binding:
  description: TSI KEYS child node.
  properties:
    pin:
      type: int
      required: true
      enum:
        - 0
        - 1
        - 2
        - 3
        - 4
        - 5
        - 6
        - 7
        - 8
        - 9
        - 10
        - 11
        - 12
        - 13
        - 14
        - 15
      description: |
        Pin-number where the electrode is connected.

    low-power-scan-pin:
      type: boolean
      description: |
        Whether this pin is the low-power-scan-pin

    press-threshold:
      type: int
      required: true
      description: |
        Counter value to consider a key pressed.

    zephyr,code:
      type: int
      required: true
      description: Key code to emit.
```

## dts/bindings/solomon,ssd1311-i2c.yaml
```yaml
# Copyright (c) 2018, NXP
# SPDX-License-Identifier: Apache-2.0

description: SSD1311 LCD

compatible: "solomon,ssd1311"

include: ["i2c-device.yaml", "solomon,ssd1311-common.yaml"]
```

## dts/bindings/solomon,ssd1311-spi.yaml
```yaml
# Copyright (c) 2018, NXP
# SPDX-License-Identifier: Apache-2.0

description: SSD1311 LCD

compatible: "solomon,ssd1311"

include: ["spi-device.yaml", "solomon,ssd1311-common.yaml"]
```

## dts/bindings/solomon,ssd1311.yaml
```yaml
description: SSD1311 LCD

compatible: "solomon,ssd1311"

include: [auxdisplay-device.yaml]

properties:
  font-width:
    type: int
    required: false
    description: Font width
    enum:
      - 5
      - 6

  invert-cursor:
    type: boolean
    required: false

  reset-gpios:
    type: phandle-array
    required: false
    description: Reset pin

  phys-rows:
    type: int
    required: false
    default: 4
```

## soc/nxp/kinetis/k7x/Kconfig
```kconfig
# Kinetis K7x series configuration

# Copyright 2024 NXP
# SPDX-License-Identifier: Apache-2.0

config SOC_SERIES_KINETIS_K7X
	select ARM
	select CPU_CORTEX_M4
	select CPU_CORTEX_M_HAS_DWT
	select CPU_HAS_NXP_SYSMPU
#	select HAS_MCUX_PIT
#	select CLOCK_CONTROL
#	select SOC_RESET_HOOK
#	select SOC_EARLY_INIT_HOOK

config SOC_MK70F12
#	select HAS_MCUX
#	select HAS_MCUX_ADC16
#	select HAS_MCUX_ENET
#	select HAS_MCUX_FLEXCAN
#	select HAS_MCUX_FTFX
#	select HAS_MCUX_FTM
#	select HAS_MCUX_RNGA
#	select HAS_MCUX_SIM
	select HAS_OSC
	select HAS_MCG
	select CPU_HAS_FPU
#	select HAS_MCUX_RTC
#	select HAS_MCUX_DAC
#	select HAS_MCUX_EDMA
#	select HAS_MCUX_RCM
```

## soc/nxp/kinetis/k7x/Kconfig.soc
```kconfig
# Kinetis K6X MCU line

# Copyright (c) 2016 Open-RnD Sp. z o.o.
# Copyright 2024 NXP
# SPDX-License-Identifier: Apache-2.0

config SOC_SERIES_KINETIS_K7X
	bool
	select SOC_FAMILY_KINETIS

config SOC_SERIES
	default "k7x" if SOC_SERIES_KINETIS_K7X

config SOC_MK70F12
	bool
	select SOC_SERIES_KINETIS_K7X

config SOC
	default "mk70f12" if SOC_MK70F12

config SOC_PART_NUMBER_MK70FN1M0CAJ12
	bool

config SOC_PART_NUMBER
	default "MK70FN1M0CAJ12" if SOC_PART_NUMBER_MK70FN1M0CAJ12
```
